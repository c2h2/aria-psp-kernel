## drivers/staging/rtl8188eu/Kconfig
```kconfig
config R8188EU
	tristate "Realtek RTL8188EU Wireless LAN NIC driver"
	depends on USB && WLAN && RFKILL
	select WIRELESS_EXT
	select WEXT_PRIV
	select CFG80211
	default n
	---help---
	This option adds the Realtek RTL8188EU USB device. If
          built as a module, it will be called r8188eu.
```

## drivers/staging/rtl8723au_bt/Kconfig
```kconfig
config R8723AU_BT
	tristate "Realtek RTL8723AU Bluetooth driver"
	depends on BT && BT_HCIBTUSB && BT_RFCOMM
	default n
	---help---
	This option adds the Realtek RTL8723AU BT device such as found in
	the Lenovo Yogi 13 tablet. If built as a module, it will be called r8723au_bt.
```
